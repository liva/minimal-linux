## drivers/Kconfig
```kconfig
# SPDX-License-Identifier: GPL-2.0
menu "Device Drivers"

source "drivers/base/Kconfig"

# input before char - char/joystick depends on it. As does USB.

source "drivers/input/Kconfig"

source "drivers/char/Kconfig"

source "drivers/video/Kconfig"

source "drivers/rtc/Kconfig"

source "drivers/clocksource/Kconfig"

endmenu
```

## drivers/video/Kconfig
```kconfig
#
# Video configuration
#

menu "Graphics support"
	depends on HAS_IOMEM

config HAVE_FB_ATMEL
	bool

config SH_LCD_MIPI_DSI
	bool

config VGASTATE
       tristate
       default n

config VIDEOMODE_HELPERS
	bool

config HDMI
	bool

if VT
	source "drivers/video/console/Kconfig"
endif

endmenu
```
